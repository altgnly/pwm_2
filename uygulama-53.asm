	LIST P=16F877A
	#INCLUDE <P16F877A.INC>
	__CONFIG H'3F31'
	SAYICI1 EQU 0X20
	SAYICI2 EQU 0X21
	ORG 0X000
	GOTO ANA_METOT
	
ANA_METOT
	BANKSEL TRISA
	MOVLW 0X06
	MOVWF ADCON1
	MOVLW 0XFF
	MOVWF TRISA
	CLRF TRISC
	BANKSEL PORTA
	MOVLW 0XFF
	MOVWF PORTA
	CLRF TRISC

	BANKSEL T2CON
	MOVLW B'00000101'
	MOVWF T2CON
	BANKSEL T2CON

	BANKSEL PR2
	MOVLW D'99'
	MOVWF PR2
	
	BANKSEL CCPR1L
	MOVLW B'00010100'	;D'20'
	MOVWF CCPR1L 

	BANKSEL CCP1CON
	MOVLW B'00001100'
	MOVWF CCP1CON
	BANKSEL CCP1CON

KONTROL
	BTFSC PORTA,0
	GOTO ARTIR
	BTFSC PORTA,1
	GOTO AZALT
	GOTO KONTROL

ARTIR
	CALL GECIKME
	MOVLW D'100'
	SUBWF CCPR1L,W
	BTFSC STATUS,Z
	GOTO KONTROL
	MOVLW D'10'
	ADDWF CCPR1L,F
	GOTO KONTROL

AZALT
	CALL GECIKME
	MOVLW H'00'
	SUBWF CCPR1L,W
	BTFSC STATUS,Z
	GOTO KONTROL
	MOVLW D'10'
	SUBWF CCPR1L,F
	GOTO KONTROL 
	
GECIKME
	MOVLW 0XFF
	MOVWF SAYICI1
	
TEKRAR1
	MOVLW 0XFF
	MOVWF SAYICI2
	
TEKRAR2
	DECFSZ SAYICI2,F
	GOTO TEKRAR2
	DECFSZ SAYICI1,F
	GOTO TEKRAR1
	RETURN
	
END